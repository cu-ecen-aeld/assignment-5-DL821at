## base_external/configs/aesd_qemu_defconfig
```kconfig
BR2_aarch64=y

# Unique to aesd_qemu_defconfig:
BR2_DL_DIR="/home/dlee/dlcache"           # Download directory (aesd_qemu)
BR2_SYSTEM_DHCP="eth0"                    # Set DHCP interface (aesd_qemu)
BR2_TARGET_GENERIC_ROOT_PASSWD="root"     # [Added] Set default root password
BR2_PACKAGE_DROPBEAR=y                    # Enable Dropbear SSH server (aesd_qemu)
BR2_PACKAGE_HOST_MKPASSWD=y               # Host mkpasswd utility (aesd_qemu)
BR2_PACKAGE_HOST_QEMU=y                   # Host QEMU support (aesd_qemu)
BR2_PACKAGE_HOST_QEMU_SYSTEM_MODE=y       # QEMU system mode support (aesd_qemu)
BR2_ROOTFS_POST_IMAGE_SCRIPT="../base_external/scripts/post-image.sh"
BR2_EXTERNAL="../base_external"


BR2_ROOTFS_OVERLAY="../base_external/rootfs_overlay"
BR2_LINUX_KERNEL=y
BR2_LINUX_KERNEL_USE_ARCH_DEFAULT_CONFIG=y
BR2_PACKAGE_KMOD=y
BR2_PACKAGE_KVMTOOL=y                     # Retained from a7_successful_build_defconfig
BR2_TARGET_ROOTFS_EXT2=y
BR2_TARGET_ROOTFS_EXT2_4=y
BR2_TARGET_ROOTFS_EXT2_SIZE="200M"
# BR2_TARGET_ROOTFS_TAR is not set
BR2_PACKAGE_AESD_ASSIGNMENTS=y
BR2_PACKAGE_LDD3=y

# [Added] Enable BusyBox syslog daemon to capture kernel messages in /var/log/messages.
BR2_PACKAGE_BUSYBOX=y
BR2_BUSYBOX_CONFIG_FRAGMENT_FILES="board/qemu/syslogd.cfg"
```

## base_external/package/ldd/Config.in
```kconfig
config BR2_PACKAGE_LDD
	bool "ldd"
	help
	  Includes scull and misc-modules in the kernel image.
	  Used to understand buildroot external trees and package builds.
```

## base_external/package/ldd3/Config.in
```kconfig
config BR2_PACKAGE_LDD3
	bool "ldd3"
	help
	  Includes scull and misc-modules in the kernel image.
	  Used to understand buildroot external trees and package builds.
```
